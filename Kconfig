## Kconfig
```kconfig
#
# Renesas device configuration
#

menuconfig AVB_MSE
	bool "AVB MSE"
	default y
	---help---
	  This option enable Renesas AVB Media Streaming Engine (MSE) driver.
	  MSE contains following sub modules.
	  - MSE Core module
	  - MSE EAVB Adapter
	  - MSE ALSA Adapter
	  - MSE V4L2 Adapter
	  - MSE MCH Adapter

if AVB_MSE

config MSE_CORE
	tristate "MSE Core module"
	default m
	---help---
	  This option enable core functions in MSE.
	  Core functions contains following features.
	  - In kernel API for MSE Adapters.
	  - Sysfs and ioct I/F for configuration by userland process.
	  - AVTP Packetizer/De-Packetizer.

config MSE_IOCTL
	bool "MSE ioctl interface for configuration"
	depends on MSE_CORE
	default y
	---help---
	  This option enable ioctl interface for MSE.
	  Say Y here to enable ioctl interface.
	  Say N if unsure.

config MSE_SYSFS
	bool "MSE sysfs interface for configuration"
	depends on MSE_CORE
	default y
	---help---
	  This option enable sysfs interface for MSE.
	  Say Y here to enable sysfs interface.
	  Say N if unsure.

config MSE_PACKETIZER_AAF
	bool "MSE Packetizer AAF"
	depends on MSE_CORE
	default y
	---help---
	  This option enable packetizer functions in MSE.
	  Say Y here to enable AVTP Packetizer/De-Packetizer AAF.
	  Say N if unsure.

config MSE_PACKETIZER_IEC61883_4
	bool "MSE Packetizer IEC61883_4"
	depends on MSE_CORE
	default y
	---help---
	  This option enable packetizer functions in MSE.
	  Say Y here to enable AVTP Packetizer/De-Packetizer IEC61883_4.
	  Say N if unsure.

config MSE_PACKETIZER_IEC61883_6
	bool "MSE Packetizer IEC61883_6"
	depends on MSE_CORE
	default y
	---help---
	  This option enable packetizer functions in MSE.
	  Say Y here to enable AVTP Packetizer/De-Packetizer IEC61883_6.
	  Say N if unsure.

config MSE_PACKETIZER_CVF_H264
	bool "MSE Packetizer CVF_H264"
	depends on MSE_CORE
	default y
	---help---
	  This option enable packetizer functions in MSE.
	  Say Y here to enable AVTP Packetizer/De-Packetizer CVF_H264.
	  Say N if unsure.

config MSE_PACKETIZER_CVF_H264_SINGLE_NAL
	bool "MSE Packetizer CVF_H264 Single NAL format"
	depends on MSE_CORE
	depends on MSE_PACKETIZER_CVF_H264
	default y
	---help---
	  This option enable packetizer functions in MSE.
	  Say Y here to enable AVTP Packetizer CVF_H264 Single NAL format.
	  Say N if unsure.

config MSE_PACKETIZER_CVF_MJPEG
	bool "MSE Packetizer CVF_MJPEG"
	depends on MSE_CORE
	default y
	---help---
	  This option enable packetizer functions in MSE.
	  Say Y here to enable AVTP Packetizer/De-Packetizer CVF_MJPEG.
	  Say N if unsure.

config MSE_ADAPTER_EAVB
	tristate "MSE EAVB Adapter"
	depends on MSE_CORE
	depends on RAVB_STREAMING || IGB_STREAMING
	default m
	---help---
	  Renesas Ethernet AVB software
	  Support MSE Adapter for Renesas AVB Streaming driver

config MSE_ADAPTER_ALSA
	tristate "MSE ALSA Adapter"
	depends on MSE_CORE
	default m
	---help---
	  Renesas Ethernet AVB software
	  Support MSE Adapter for Linux ALSA

config MSE_ADAPTER_V4L2
	tristate "MSE V4L2 Adapter"
	depends on MSE_CORE
	select VIDEOBUF2_VMALLOC
	default m
	---help---
	  Renesas Ethernet AVB software.
	  Support MSE Adapter for V4L2.

config MSE_ADAPTER_MCH
	tristate "MSE MCH Adapter"
	depends on MSE_CORE
	depends on MCH_CORE
	default m
	---help---
	  Renesas Ethernet AVB software.
	  Support MSE Adapter for MCH.

endif
```
